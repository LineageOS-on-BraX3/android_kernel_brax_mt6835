## drivers/input/fingerprint/Kconfig
```kconfig
#
#Fingerprint
#
menu "Fingerprint support"
	depends on INPUT

config MTK_FINGERPRINT_SUPPORT
	#bool "Mediatek Fingerprint"
	tristate "Mediatek Fingerprint"
	default n
	help
	  Fingerprint mtk driver enable/disable
	  in the kernel.Say Y here if you want to
	  use mediatek fingerprint driver,fingerprint
	  driver will support fingerprint function

source "drivers/input/fingerprint/focaltech_fp/Kconfig"

endmenu
```

## drivers/input/touchscreen/omnivision_tcm/Kconfig
```kconfig
config TOUCHSCREEN_OMNIVISION_TCM
	tristate "Omnivision_tcm Touchscreen"
	default m
	help
	Say Y here if you have Omnivision_tcm touch panel.
	If unsure, say N.
        
config TOUCHSCREEN_OMNIVISION_TCM_EAR_PHONE
    tristate "Omnivision TCM earphone mode"
	help
	  Say Y here to enable support for open ear mode functionality.

	  If unsure, say N.

config TOUCHSCREEN_OMNIVISION_TCM_CHARGER
	tristate "Omnivision TCM charger mode"
	help
	  Say Y here to enable support for open charger mode functionality.

	  If unsure, say N.
```

## drivers/misc/mediatek/prize/cs_notifier/Kconfig
```kconfig
# SPDX-License-Identifier: GPL-2.0-only

config CS_NOTIFIER
	tristate "Enable CS notifier Control"
	help
	  CS notifier for any drivers who want to use.
	  
```

## drivers/misc/mediatek/prize/cs_usb_broadcast/Kconfig
```kconfig
# SPDX-License-Identifier: GPL-2.0-only

config CS_USB_BROADCAST
 	tristate "Enable CS USB BROADCAST Control"
 	help
 	  This is used for usb plug in/out notify.
```

## drivers/misc/mediatek/prize/prize_common_node/Kconfig
```kconfig
config PRIZE_COMMON_NODE
	tristate "common node"
	default n
	help
	  common_node. If configures to be n, means devices doesn't support
	  common_node functionality.
 
```

## drivers/misc/mediatek/typec/tcpc/aw35615/Kconfig
```kconfig
#
# awinic driver configuration
#

config TCPC_AW35615_PD
       tristate "Richtek AW35615_PD TypeC port Controller Driver"
       depends on TCPC_CLASS
       default n
       help
         Say Y to enable
         Richtek AW35615_PD
         TypeC port Controller
         Driver
```
